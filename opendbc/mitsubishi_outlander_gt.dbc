VERSION ""

NS_ :

BS_:

BU_: XXX

BO_ 566 STEER_ANGLE_SENSOR: 8 XXX
 SG_ STEER_ANGLE : 0|16@1- (-0.5,0) [0|1800] "degree" XXX

BO_ 753 STEER_MOMENT_SENSOR: 8 XXX
 SG_ STEER_MOMENT : 16|32@1- (1,0) [0|65535] "" XXX

BO_ 528 GAS_PEDAL: 8 XXX
 SG_ GAS_PEDAL : 24|8@0+ (1,0) [0|255] "" XXX

BO_ 536 GEARBOX: 8 XXX
 SG_ GEAR_SHIFTER : 16|3@0+ (1,0) [0|255] "" XXX
